## prj.conf
```kconfig
CONFIG_NETWORKING=y
CONFIG_NET_UDP=y
CONFIG_NET_IPV6=y
#CONFIG_NET_IPV4=y
#CONFIG_NET_DHCPV4=y

CONFIG_RANDOM_GENERATOR=y
CONFIG_TEST_RANDOM_GENERATOR=y
CONFIG_INIT_STACKS=y

#CONFIG_NEWLIB_LIBC=y
#CONFIG_CONSOLE_HANDLER=y
#CONFIG_EARLY_CONSOLE=y
#CONFIG_STDOUT_CONSOLE=y

#CONFIG_NET_LOG=y
#CONFIG_SYS_LOG_NET_LEVEL=4
#CONFIG_SYS_LOG_SHOW_COLOR=y
#CONFIG_NET_STATISTICS=y
#CONFIG_PRINTK=y

CONFIG_NET_SLIP_TAP=y

CONFIG_NET_PKT_RX_COUNT=10
CONFIG_NET_PKT_TX_COUNT=10
CONFIG_NET_BUF_RX_COUNT=20
CONFIG_NET_BUF_TX_COUNT=20
CONFIG_NET_CONTEXT_NET_PKT_POOL=y

CONFIG_NET_IF_UNICAST_IPV6_ADDR_COUNT=3
CONFIG_NET_IF_MCAST_IPV6_ADDR_COUNT=4
CONFIG_NET_MAX_CONTEXTS=10

#CONFIG_NET_SHELL=y

CONFIG_NET_APP_SETTINGS=y
CONFIG_NET_APP_NEED_IPV6=y
#CONFIG_NET_APP_NEED_IPV4=y
#CONFIG_NET_APP_SERVER=y
#CONFIG_NET_DEBUG_APP=y
CONFIG_NET_APP_MY_IPV6_ADDR="2001:db8::1"
CONFIG_NET_APP_PEER_IPV6_ADDR="2001:db8::2"
#CONFIG_NET_APP_MY_IPV4_ADDR="192.0.2.1"
#CONFIG_NET_APP_PEER_IPV4_ADDR="192.0.2.2"

#CONFIG_NET_DEBUG_CONTEXT=n

CONFIG_MAIN_STACK_SIZE=4096
```

## prj_802154.conf
```kconfig
CONFIG_NETWORKING=y
CONFIG_NETWORKING_WITH_LOGGING=y
CONFIG_IP_BUF_RX_SIZE=3
CONFIG_IP_BUF_TX_SIZE=3
CONFIG_NANO_TIMEOUTS=y
CONFIG_NETWORKING_WITH_15_4=y
CONFIG_NETWORKING_WITH_15_4_TI_CC2520=y
CONFIG_TI_CC2520_DEBUG=y
CONFIG_NETWORKING_WITH_6LOWPAN=y
CONFIG_6LOWPAN_COMPRESSION_IPHC=y
#CONFIG_NETWORKING_WITH_15_4_MAC_CSMA=y

CONFIG_TI_CC2520_CHANNEL=26

CONFIG_MINIMAL_LIBC_EXTENDED=y
CONFIG_STDOUT_CONSOLE=y
CONFIG_ARC_INIT=n
#CONFIG_NETWORK_IP_STACK_DEBUG_RECV_SEND=y
#CONFIG_NETWORK_IP_STACK_DEBUG_NET_BUF=y
#CONFIG_DEBUG_IP_BUFS=y
#CONFIG_NETWORK_IP_STACK_DEBUG_IPV6=y
#CONFIG_NETWORK_IP_STACK_DEBUG_IPV6_DS=y
#CONFIG_NETWORK_IP_STACK_DEBUG_IPV6_ICMPV6=y
#CONFIG_NETWORK_IP_STACK_DEBUG_IPV6_ND=y
#CONFIG_NETWORK_IP_STACK_DEBUG_IPV6_NBR_CACHE=y
#CONFIG_NETWORK_IP_STACK_DEBUG_IPV6_ROUTE=y
CONFIG_INIT_STACKS=n
CONFIG_PRINTK=n
```

## prj_bt.conf
```kconfig
CONFIG_NETWORKING=y
CONFIG_NET_IPV6=y
CONFIG_NET_UDP=y

CONFIG_TEST_RANDOM_GENERATOR=y
CONFIG_INIT_STACKS=y

CONFIG_NEWLIB_LIBC=y
CONFIG_STDOUT_CONSOLE=y

CONFIG_NET_PKT_RX_COUNT=10
CONFIG_NET_PKT_TX_COUNT=10
CONFIG_NET_BUF_RX_COUNT=20
CONFIG_NET_BUF_TX_COUNT=20
CONFIG_NET_IF_UNICAST_IPV6_ADDR_COUNT=3
CONFIG_NET_IF_MCAST_IPV6_ADDR_COUNT=2
CONFIG_NET_MAX_CONTEXTS=6

CONFIG_BT=y
CONFIG_BT_SMP=y
CONFIG_BT_PERIPHERAL=y
CONFIG_BT_L2CAP_DYNAMIC_CHANNEL=y
CONFIG_NET_L2_BT_ZEP1656=y
CONFIG_NET_L2_BT=y
CONFIG_BT_DEVICE_NAME="OCF_BLE_NODE"

CONFIG_NET_APP_SETTINGS=y
CONFIG_NET_APP_MY_IPV6_ADDR="2001:db8::1"
CONFIG_NET_APP_PEER_IPV6_ADDR="2001:db8::2"
CONFIG_NET_APP_AUTO_INIT=n

CONFIG_MAIN_STACK_SIZE=4096
```

## prj_secure.conf
```kconfig
CONFIG_NETWORKING=y
CONFIG_NET_IPV6=y
CONFIG_NET_UDP=y
CONFIG_NANO_TIMEOUTS=y
CONFIG_TEST_RANDOM_GENERATOR=y
CONFIG_NET_LOG=y

CONFIG_NET_SLIP=y
CONFIG_NET_SLIP_TAP=y

CONFIG_INIT_STACKS=y
CONFIG_PRINTK=n
CONFIG_STDOUT_CONSOLE=y

CONFIG_NET_NBUF_RX_COUNT=14
CONFIG_NET_NBUF_TX_COUNT=14
CONFIG_NET_IF_UNICAST_IPV6_ADDR_COUNT=2
CONFIG_NET_IF_MCAST_IPV6_ADDR_COUNT=1
CONFIG_NET_MAX_CONTEXTS=4

CONFIG_MAIN_STACK_SIZE=2048

CONFIG_FLASH=y
CONFIG_SPI=y
CONFIG_GPIO=y
CONFIG_SPI_CS_GPIO=y
CONFIG_SPI_0_CS_GPIO_PIN=24

CONFIG_NET_APP_SETTINGS=y
CONFIG_NET_APP_MY_IPV6_ADDR="2001:db8::1"
CONFIG_NET_APP_PEER_IPV6_ADDR="2001:db8::2"
```

## src/main.c
```c
/*
 // Copyright (c) 2016 Intel Corporation
 //
 // Licensed under the Apache License, Version 2.0 (the "License");
 // you may not use this file except in compliance with the License.
 // You may obtain a copy of the License at
 //
 //      http://www.apache.org/licenses/LICENSE-2.0
 //
 // Unless required by applicable law or agreed to in writing, software
 // distributed under the License is distributed on an "AS IS" BASIS,
 // WITHOUT WARRANTIES OR CONDITIONS OF ANY KIND, either express or implied.
 // See the License for the specific language governing permissions and
 // limitations under the License.
 */

#include <zephyr.h>
#include <sections.h>
#include "oc_main.h"
#include "port/oc_clock.h"

#define STACKSIZE 1024
static char __noinit __stack event_loop[STACKSIZE];

void main_loop() {
  oc_main_init();
  while (1) {
    oc_main_poll();
    fiber_sleep(10);
  }
  oc_main_shutdown();
}

void main(void) {
  task_fiber_start(&event_loop[0], STACKSIZE,
		   (nano_fiber_entry_t)main_loop, 0, 0, 7, 0);
}
```

## src/abort.c
```c
#include "port/oc_assert.h"

// TODO:
void abort_impl() {}

void exit_impl(int status) {}
```

## src/assert.h
```c
/****************************************************************************
 *
 * Copyright (c) 2016 Intel Corporation
 *
 * Licensed under the Apache License, Version 2.0 (the "License"),
 * you may not use this file except in compliance with the License.
 * You may obtain a copy of the License at
 *
 *      http://www.apache.org/licenses/LICENSE-2.0
 *
 * Unless required by applicable law or agreed to in writing,
 * software distributed under the License is distributed on an
 * "AS IS" BASIS, WITHOUT WARRANTIES OR CONDITIONS OF ANY KIND,
 * either express or implied. See the License for the specific
 * language governing permissions and limitations under the License.
 *
 ****************************************************************************/

#ifndef ASSERT_H
#define ASSERT_H

#include "port/oc_assert.h"

#define assert oc_assert

#endif
```

## src/clock.c
```c
/******************************************************************
 *
 * Copyright (c) 2016 Intel Corporation
 *
 * Licensed under the Apache License, Version 2.0 (the "License"),
 * you may not use this file except in compliance with the License.
 * You may obtain a copy of the License at
 *
 *      http://www.apache.org/licenses/LICENSE-2.0
 *
 * Unless required by applicable law or agreed to in writing, software
 * distributed under the License is distributed on an "AS IS" BASIS,
 * WITHOUT WARRANTIES OR CONDITIONS OF ANY KIND, either express or implied.
 * See the License for the specific language governing permissions and
 * limitations under the License.
 *
 ******************************************************************/

#include "port/oc_clock.h"

void
oc_clock_init(void)
{
}

oc_clock_time_t
oc_clock_time(void)
{
  return k_uptime_get();
}

bool
oc_clock_time_has_monotonic_clock(void)
{
  return false;
}

oc_clock_time_t
oc_clock_time_monotonic(void)
{
  return oc_clock_time();
}

uint64_t
oc_clock_seconds_v1(void)
{
  return (oc_clock_time() + OC_CLOCK_SECOND - 1) / OC_CLOCK_SECOND;
}

unsigned long
oc_clock_seconds(void)
{
  return (unsigned long)oc_clock_seconds_v1();
}

void
oc_clock_wait(oc_clock_time_t t)
{
  k_sleep(t);
}
```

## src/config.h
```c
/*
 // Copyright (c) 2016 Intel Corporation
 //
 // Licensed under the Apache License, Version 2.0 (the "License");
 // you may not use this file except in compliance with the License.
 // You may obtain a copy of the License at
 //
 //      http://www.apache.org/licenses/LICENSE-2.0
 //
 // Unless required by applicable law or agreed to in writing, software
 // distributed under the License is distributed on an "AS IS" BASIS,
 // WITHOUT WARRANTIES OR CONDITIONS OF ANY KIND, either express or implied.
 // See the License for the specific language governing permissions and
 // limitations under the License.
 */

#ifndef CONFIG_H
#define CONFIG_H

/* Time resolution */
#include <stdint.h>
typedef uint64_t oc_clock_time_t;
#include <zephyr.h>
#define OC_CLOCK_CONF_TICKS_PER_SECOND (1000)

#define OC_BYTES_POOL_SIZE (1024)
#define OC_INTS_POOL_SIZE (16)
#define OC_DOUBLES_POOL_SIZE (16)

/* Server-side parameters */
/* Maximum number of server resources */
#define OC_MAX_APP_RESOURCES (1)

/* Common paramters */
//#define OC_BLOCK_WISE_SET_MTU (80)

/* Maximum size of request/response PDUs */
#define OC_MAX_APP_DATA_SIZE (600)

/* Maximum number of concurrent requests */
#define OC_MAX_NUM_CONCURRENT_REQUESTS (2)

/* Maximum number of nodes in a payload tree structure */
#define OC_MAX_NUM_REP_OBJECTS (70)

/* Number of devices on the OCF platform */
#define OC_MAX_NUM_DEVICES (1)

#define OC_MAX_NUM_ENDPOINTS (4)

/* Security layer */
/* Maximum number of authorized clients */
#define OC_MAX_NUM_SUBJECTS (1)

/* Maximum number of concurrent DTLS sessions */
#define OC_MAX_DTLS_PEERS (1)

/* Max inactivity timeout before tearing down DTLS connection */
#define OC_DTLS_INACTIVITY_TIMEOUT (10)

#endif /* CONFIG_H */
```

## src/ipadapter.c
```c
/******************************************************************
 *
 * Copyright (c) 2016 Intel Corporation
 *
 * Licensed under the Apache License, Version 2.0 (the "License"),
 * you may not use this file except in compliance with the License.
 * You may obtain a copy of the License at
 *
 *      http://www.apache.org/licenses/LICENSE-2.0
 *
 * Unless required by applicable law or agreed to in writing, software
 * distributed under the License is distributed on an "AS IS" BASIS,
 * WITHOUT WARRANTIES OR CONDITIONS OF ANY KIND, either express or implied.
 * See the License for the specific language governing permissions and
 * limitations under the License.
 *
 ******************************************************************/

#include "api/oc_network_events_internal.h"
#include "port/oc_connectivity.h"
#include "port/oc_log_internal.h"
#include "port/oc_network_event_handler_internal.h"
#include "oc_buffer.h"
#include "oc_endpoint.h"
#include <errno.h>
#include <stdio.h>
#include <zephyr.h>

#include <net/net_context.h>
#include <net/net_core.h>
#include <net/net_if.h>
#include <net/net_pkt.h>

/* Server's receive socket */
static struct net_context *udp_recv6;

/* "All OCF nodes" multicast address and port */
#define OCF_MCAST_IP6ADDR                                                      \
  {                                                                            \
    {                                                                          \
      {                                                                        \
        0xff, 0x02, 0, 0, 0, 0, 0, 0, 0, 0, 0, 0, 0, 0, 0x01, 0x58             \
      }                                                                        \
    }                                                                          \
  }
static struct in6_addr in6addr_mcast = OCF_MCAST_IP6ADDR;
#define OCF_MCAST_PORT (5683)
/* Multicast receive socket */
static struct net_context *mcast_recv6;
static struct sockaddr_in6 mcast_addr6;
static struct sockaddr_in6 my_addr6;

static struct in6_addr in6addr_my;

#ifdef OC_SECURITY
/* DTLS receive socket */
static struct net_context *dtls_recv6;
static struct sockaddr_in6 dtls_addr6;
#define MY_DTLS_PORT (56789)
#endif /* OC_SECURITY */
static oc_endpoint_t *eps;
/* For synchronizing the network receive thread with IoTivity-Lite's
 * event loop.
 */
static struct k_sem sem;

void
oc_network_event_handler_mutex_init(void)
{
  k_sem_init(&sem, 0, 1);
  k_sem_give(&sem);
}

void
oc_network_event_handler_mutex_lock(void)
{
  k_sem_take(&sem, K_FOREVER);
}

void
oc_network_event_handler_mutex_unlock(void)
{
  k_sem_give(&sem);
}

void
oc_network_event_handler_mutex_destroy(void)
{
}

static void
oc_network_receive(struct net_context *context, struct net_pkt *pkt, int status,
                   void *user_data)
{
  oc_message_t *message = oc_allocate_message();

  if (message) {
    uint16_t pos;
    struct net_udp_hdr *udp =
      (struct net_udp_hdr *)((u8_t *)(NET_IPV6_HDR(pkt)) +
                             sizeof(struct net_ipv6_hdr));
    size_t bytes_read = net_pkt_appdatalen(pkt);
    if (bytes_read < 0) {
      oc_message_unref(message);
      return;
    }

    size_t offset_from_start = net_pkt_get_len(pkt) - bytes_read;
    bytes_read = (bytes_read < OC_PDU_SIZE) ? bytes_read : OC_PDU_SIZE;
    struct net_buf *frag = net_frag_read(pkt->frags, offset_from_start, &pos,
                                         bytes_read, message->data);
    if (!frag && pos == 0xffff) {
      net_pkt_unref(pkt);
      oc_message_unref(message);
      return;
    }

    message->length = bytes_read;
    if (user_data != NULL) {
      message->endpoint.flags = IPV6 | SECURED;
#ifdef OC_SECURITY
      message->encrypted = 1;
#endif /* OC_SECURITY */
    } else
      message->endpoint.flags = IPV6;
    memcpy(message->endpoint.addr.ipv6.address, &NET_IPV6_HDR(pkt)->src, 16);
    message->endpoint.addr.ipv6.scope = 0;
    message->endpoint.addr.ipv6.port = ntohs(udp->src_port);
    message->endpoint.device = 0;

    OC_DBG("oc_network_receive: received %d bytes", (int)message->length);
    OC_DBG("oc_network_receive: incoming message from");
    OC_LOGipaddr(OC_LOG_LEVEL_DEBUG, message->endpoint);
    OC_DBG("%s", "");
    oc_network_receive_event(message);
  }

  net_pkt_unref(pkt);
}

static inline void
udp_sent(struct net_context *context, int status, void *token, void *user_data)
{
  if (!status) {
    OC_DBG("oc_send_buffer: sent %d bytes", POINTER_TO_UINT(token));
  } else if (status < 0) {
    OC_DBG("oc_send_buffer: failed: (%d)", status);
  }
}

int
oc_send_buffer(oc_message_t *message)
{
  OC_DBG("oc_send_buffer: outgoing message to");
  OC_LOGipaddr(OC_LOG_LEVEL_DEBUG, message->endpoint);
  OC_DBG("%s", "");

  /* Populate destination address structure */
  struct sockaddr_in6 peer_addr;
  memcpy(peer_addr.sin6_addr.in6_u.u6_addr8,
         message->endpoint.addr.ipv6.address, 16);
  peer_addr.sin6_family = AF_INET6;
  peer_addr.sin6_port = htons(message->endpoint.addr.ipv6.port);

  /* Network buffer to hold data to be sent */
  struct net_pkt *send_pkt;
#ifdef OC_SECURITY
  if (message->endpoint.flags & SECURED) {
    send_pkt = net_pkt_get_tx(dtls_recv6, K_NO_WAIT);
  } else
#endif /* OC_SECURITY */
  {
    send_pkt = net_pkt_get_tx(udp_recv6, K_NO_WAIT);
  }
  if (!send_pkt) {
    OC_WRN("oc_send_buffer: cannot acquire send_pkt");
    return -1;
  }

  bool status =
    net_pkt_append_all(send_pkt, message->length, message->data, K_NO_WAIT);
  if (!status) {
    OC_WRN("oc_send_buffer: cannot populate send_pkt");
    return -1;
  }

  int ret = net_context_sendto(
    send_pkt, (struct sockaddr *)&peer_addr, sizeof(struct sockaddr_in6),
    udp_sent, 0, UINT_TO_POINTER(net_pkt_get_len(send_pkt)), NULL);
  if (ret < 0) {
    OC_WRN("oc_send_buffer: cannot send data to peer (%d)", ret);
    net_pkt_unref(send_pkt);
    return ret;
  }
  return message->length;
}

int
oc_send_buffer2(oc_message_t *message, bool queue)
{
  (void)queue;
  return oc_send_buffer(message);
}

static void
free_endpoints(void)
{
  oc_endpoint_t *ep = eps, *next;
  while (ep != NULL) {
    next = ep->next;
    oc_free_endpoint(ep);
    ep = next;
  }
}

oc_endpoint_t *
oc_connectivity_get_endpoints(size_t device)
{
  (void)device;
  if (!eps) {
    oc_endpoint_t *ep = oc_new_endpoint();
    if (!ep) {
      return NULL;
    }
    eps = ep;
    memset(ep, 0, sizeof(oc_endpoint_t));
    ep->flags = IPV6;
    net_addr_pton(AF_INET6, CONFIG_NET_APP_MY_IPV6_ADDR, ep->addr.ipv6.address);
    ep->addr.ipv6.port = ntohs(my_addr6.sin6_port);
    ep->device = 0;
#ifdef OC_SECURITY
    oc_endpoint_t *ep_sec = oc_new_endpoint();
    if (ep_sec) {
      memset(ep_sec, 0, sizeof(oc_endpoint_t));
      ep_sec->flags = IPV6 | SECURED;
      net_addr_pton(AF_INET6, CONFIG_NET_APP_MY_IPV6_ADDR,
                    ep_sec->addr.ipv6.address);
      ep_sec->addr.ipv6.port = ntohs(dtls_addr6.sin6_port);
      ep_sec->device = 0;
      ep->next = ep_sec;
    }
#endif /* OC_SECURITY */
  }
  return eps;
}

int
oc_connectivity_init(size_t device, oc_connectivity_ports_t ports)
{
  // TODO set ports
  (void)ports;
  (void)device;
  int ret;

  /* Record OCF's multicast address with network interface */
  net_if_ipv6_maddr_add(net_if_get_default(), &in6addr_mcast);

  net_ipaddr_copy(&mcast_addr6.sin6_addr, &in6addr_mcast);
  mcast_addr6.sin6_family = AF_INET6;
  mcast_addr6.sin6_port = htons(OCF_MCAST_PORT);

  /* Wildcard address set for server with randomly chosen port */
  my_addr6.sin6_family = AF_INET6;

  /* Add unicast IPV6 address to interface so that node can communicate */
  /* Would be good to have the address auto-configured in case some router is
   * distributing pre-fixes*/
  if (net_addr_pton(AF_INET6, CONFIG_NET_APP_MY_IPV6_ADDR, &in6addr_my) < 0) {
    NET_ERR("Invalid IPv6 address %s", CONFIG_NET_APP_MY_IPV6_ADDR);
  }

#if OC_DBG_IS_ENABLED
  struct net_if_addr *ifaddr =
#endif
    net_if_ipv6_addr_add(net_if_get_default(), &in6addr_my, NET_ADDR_MANUAL, 0);
#if OC_DBG_IS_ENABLED
  OC_DBG("=====>>>Interface unicast address added @ %p", ifaddr);
#endif

#ifdef OC_SECURITY
  dtls_addr6.sin6_port = htons(MY_DTLS_PORT);
  dtls_addr6.sin6_family = AF_INET6;
#endif /* OC_SECURITY */

  ret = net_context_get(AF_INET6, SOCK_DGRAM, IPPROTO_UDP, &udp_recv6);
  if (ret < 0) {
    OC_WRN("oc_connectivity_init: cannot get UDP network context for server"
           "receive (%d)",
           ret);
    goto error;
  }

  ret = net_context_bind(udp_recv6, (struct sockaddr *)&my_addr6,
                         sizeof(struct sockaddr_in6));
  if (ret < 0) {
    OC_WRN("oc_connectivity_init: cannot bind UDP port %d to server's network"
           "context (%d)",
           ntohs(my_addr6.sin6_port), ret);
    goto error;
  }

  ret = net_context_get(AF_INET6, SOCK_DGRAM, IPPROTO_UDP, &mcast_recv6);
  if (ret < 0) {
    OC_WRN("oc_connectivity_init: cannot get UDP network context for OCF"
           "multicast receive (%d)",
           ret);
    goto error;
  }

  ret = net_context_bind(mcast_recv6, (struct sockaddr *)&mcast_addr6,
                         sizeof(struct sockaddr_in6));
  if (ret < 0) {
    OC_WRN("oc_connectivity_init: cannot bind OCF multicast network context"
           "(%d)",
           ret);
    goto error;
  }

#ifdef OC_SECURITY
  ret = net_context_get(AF_INET6, SOCK_DGRAM, IPPROTO_UDP, &dtls_recv6);
  if (ret < 0) {
    OC_WRN("oc_connectivity_init: cannot get DTLS network context"
           "(%d)",
           ret);
    goto error;
  }

  ret = net_context_bind(dtls_recv6, (struct sockaddr *)&dtls_addr6,
                         sizeof(struct sockaddr_in6));
  if (ret < 0) {
    OC_WRN("oc_connectivity_init: cannot bind DTLS network context"
           "(%d)",
           ret);
    goto error;
  }
#endif /* OC_SECURITY */

  ret = net_context_recv(mcast_recv6, oc_network_receive, 0, NULL);
  if (ret < 0) {
    OC_WRN("oc_connectivity_init: net_context_recv error from multicast socket:"
           "(%d)",
           ret);
    goto error;
  }

  ret = net_context_recv(udp_recv6, oc_network_receive, 0, NULL);
  if (ret < 0) {
    OC_WRN("oc_connectivity_init: net_context_recv error from server socket:"
           "(%d)",
           ret);
    goto error;
  }

#ifdef OC_SECURITY
  static uint16_t dtls_port = MY_DTLS_PORT;
  ret = net_context_recv(dtls_recv6, oc_network_receive, 0, &dtls_port);
  if (ret < 0) {
    OC_WRN("oc_connectivity_init: net_context_recv error from DTLS socket:"
           "(%d)",
           ret);
    goto error;
  }
#endif /* OC_SECURITY */

  OC_DBG("oc_connectivity_init: successfully initialized connectivity");
  return 0;

error:
  OC_ERR("oc_connectivity_init: failed to initialize connectivity");
  return -1;
}

void
oc_connectivity_shutdown(size_t device)
{
  (void)device;
#ifdef OC_SECURITY
  net_context_put(dtls_recv6);
#endif /* OC_SECURITY */
  net_context_put(udp_recv6);
  net_context_put(mcast_recv6);
  free_endpoints();
}

#ifdef OC_CLIENT
void
oc_send_discovery_request(oc_message_t *message)
{
  oc_send_buffer(message);
}
#endif /* OC_CLIENT */
```

## src/ipadapter.h
```c
/****************************************************************************
 *
 * Copyright 2019 Jozef Kralik All Rights Reserved.
 *
 * Licensed under the Apache License, Version 2.0 (the "License");
 * you may not use this file except in compliance with the License.
 * You may obtain a copy of the License at
 *
 * http://www.apache.org/licenses/LICENSE-2.0
 *
 * Unless required by applicable law or agreed to in writing, software
 * distributed under the License is distributed on an "AS IS" BASIS,
 * WITHOUT WARRANTIES OR CONDITIONS OF ANY KIND, either express or implied.
 * See the License for the specific language governing permissions and
 * limitations under the License.
 *
 ******************************************************************/
#ifndef IPADAPTER_H
#define IPADAPTER_H

int set_nonblock_socket(int sockfd);

#endif /* IPADAPTER_H */
```

## src/ipcontext.h
```c
/****************************************************************************
 *
 * Copyright 2018 Samsung Electronics All Rights Reserved.
 *
 * Licensed under the Apache License, Version 2.0 (the "License");
 * you may not use this file except in compliance with the License.
 * You may obtain a copy of the License at
 *
 * http://www.apache.org/licenses/LICENSE-2.0
 *
 * Unless required by applicable law or agreed to in writing,
 * software distributed under the License is distributed on an
 * "AS IS" BASIS, WITHOUT WARRANTIES OR CONDITIONS OF ANY KIND,
 * either express or implied. See the License for the specific
 * language governing permissions and limitations under the License.
 *
 ****************************************************************************/

#ifndef IPCONTEXT_H
#define IPCONTEXT_H

#include "oc_endpoint.h"
#include "util/oc_atomic.h"
#include <pthread.h>
#include <stdint.h>
#include <sys/select.h>
#include <sys/socket.h>

#ifdef __cplusplus
extern "C" {
#endif

typedef enum {
  ADAPTER_STATUS_NONE = 0, /* Nothing happens */
  ADAPTER_STATUS_ACCEPT,   /* Receiving no meaningful data */
  ADAPTER_STATUS_RECEIVE,  /* Receiving meaningful data */
  ADAPTER_STATUS_ERROR     /* Error */
} adapter_receive_state_t;

#ifdef OC_TCP
typedef struct tcp_context_t
{
  struct sockaddr_storage server;
  int server_sock;
  uint16_t port;
#ifdef OC_SECURITY
  struct sockaddr_storage secure;
  int secure_sock;
  uint16_t tls_port;
#endif /* OC_SECURITY */
#ifdef OC_IPV4
  struct sockaddr_storage server4;
  int server4_sock;
  uint16_t port4;
#ifdef OC_SECURITY
  struct sockaddr_storage secure4;
  int secure4_sock;
  uint16_t tls4_port;
#endif /* OC_SECURITY */
#endif /* OC_IPV4 */
  int connect_pipe[2];
} tcp_context_t;
#endif

typedef enum {
  IP_CONTEXT_FLAG_REFRESH_ENDPOINT_LIST =
    1 << 0, ///< used to signal that endpoint list needs to be refreshed
} ip_context_flags_t;

typedef struct ip_context_t
{
  struct ip_context_t *next;
  OC_LIST_STRUCT(eps); /// < not thread-safe, must be used only from main thread
  struct sockaddr_storage mcast;
  struct sockaddr_storage server;
  int mcast_sock;
  int server_sock;
  uint16_t port;
  uint16_t padding;
#ifdef OC_SECURITY
  struct sockaddr_storage secure;
  int secure_sock;
  uint16_t dtls_port;
#endif /* OC_SECURITY */
#ifdef OC_IPV4
  struct sockaddr_storage mcast4;
  struct sockaddr_storage server4;
  int mcast4_sock;
  int server4_sock;
  uint16_t port4;
#ifdef OC_SECURITY
  struct sockaddr_storage secure4;
  int secure4_sock;
  uint16_t dtls4_port;
#endif /* OC_SECURITY */
#endif /* OC_IPV4 */
#ifdef OC_TCP
  tcp_context_t tcp;
#endif
  pthread_t event_thread;
  OC_ATOMIC_INT8_T terminate;
  size_t device;
  pthread_mutex_t rfds_mutex;
  fd_set rfds;
  int shutdown_pipe[2];
  OC_ATOMIC_INT8_T flags;
} ip_context_t;

/**
 * Set a given file descriptor to a set (dev->rfds) under the mutex(rfds_mutex).
 *
 * @param[in] dev the device network context.
 * @param[in] sockfd the file descriptor.
 */
void ip_context_rfds_fd_set(ip_context_t *dev, int sockfd);

/**
 * Remove a given file descriptor from a set (dev->rfds) under the
 * mutex(rfds_mutex).
 *
 * @param[in] dev the device network context.
 * @param[in] sockfd the file descriptor.
 */
void ip_context_rfds_fd_clr(ip_context_t *dev, int sockfd);

/**
 * Make a copy of file descriptor set (dev->rfds) under the mutex(rfds_mutex).
 *
 * @param[in] dev the device network context.
 *
 * @return a copy of file descriptor set.
 */
fd_set ip_context_rfds_fd_copy(ip_context_t *dev);

#ifdef __cplusplus
}
#endif

#endif /* IPCONTEXT_H */
```

## src/ipss.c
```c
/** @file
 *  @brief IP Support Service sample
 */

/*
 * Copyright (c) 2015-2016 Intel Corporation
 *
 * SPDX-License-Identifier: Apache-2.0
 */

#include <errno.h>
#include <misc/byteorder.h>
#include <misc/printk.h>
#include <stddef.h>
#include <stdint.h>
#include <string.h>
#include <zephyr.h>

#include <bluetooth/bluetooth.h>
#include <bluetooth/conn.h>
#include <bluetooth/gatt.h>
#include <bluetooth/hci.h>
#include <bluetooth/uuid.h>

static char def_device_name[20];
static char def_manufacturer_name[20];
static char def_model_number[16];
static uint16_t def_appearance = 0x0000;

#define DEFAULT_DEVICE_NAME "Test IPSP node"
#define DEVICE_NAME_LEN (20)
#define DEFAULT_APPEARANCE 0x0000
#define DEFAULT_MODEL CONFIG_SOC
#define DEFAULT_MANUFACTURER "Manufacturer"

#if !defined(CONFIG_BLUETOOTH_GATT_DYNAMIC_DB)
static ssize_t read_name(struct bt_conn *conn, const struct bt_gatt_attr *attr,
                         void *buf, uint16_t len, uint16_t offset) {
  const char *name = attr->user_data;

  return bt_gatt_attr_read(conn, attr, buf, len, offset, name, strlen(name));
}

static ssize_t read_appearance(struct bt_conn *conn,
                               const struct bt_gatt_attr *attr, void *buf,
                               uint16_t len, uint16_t offset) {
  uint16_t appearance = sys_cpu_to_le16(def_appearance);

  return bt_gatt_attr_read(conn, attr, buf, len, offset, &appearance,
                           sizeof(appearance));
}

static ssize_t read_model(struct bt_conn *conn, const struct bt_gatt_attr *attr,
                          void *buf, uint16_t len, uint16_t offset) {
  const char *value = attr->user_data;

  return bt_gatt_attr_read(conn, attr, buf, len, offset, value, strlen(value));
}

static ssize_t read_manuf(struct bt_conn *conn, const struct bt_gatt_attr *attr,
                          void *buf, uint16_t len, uint16_t offset) {
  const char *value = attr->user_data;

  return bt_gatt_attr_read(conn, attr, buf, len, offset, value, strlen(value));
}
#endif /* CONFIG_BLUETOOTH_GATT_DYNAMIC_DB */

static struct bt_gatt_attr attrs[] = {
#if !defined(CONFIG_BLUETOOTH_GATT_DYNAMIC_DB)
    BT_GATT_PRIMARY_SERVICE(BT_UUID_GAP),
    BT_GATT_CHARACTERISTIC(BT_UUID_GAP_DEVICE_NAME, BT_GATT_CHRC_READ),
    BT_GATT_DESCRIPTOR(BT_UUID_GAP_DEVICE_NAME, BT_GATT_PERM_READ, read_name,
                       NULL, def_device_name),
    BT_GATT_CHARACTERISTIC(BT_UUID_GAP_APPEARANCE, BT_GATT_CHRC_READ),
    BT_GATT_DESCRIPTOR(BT_UUID_GAP_APPEARANCE, BT_GATT_PERM_READ,
                       read_appearance, NULL, NULL),
    /* Device Information Service Declaration */
    BT_GATT_PRIMARY_SERVICE(BT_UUID_DIS),
    BT_GATT_CHARACTERISTIC(BT_UUID_DIS_MODEL_NUMBER, BT_GATT_CHRC_READ),
    BT_GATT_DESCRIPTOR(BT_UUID_DIS_MODEL_NUMBER, BT_GATT_PERM_READ, read_model,
                       NULL, def_model_number),
    BT_GATT_CHARACTERISTIC(BT_UUID_DIS_MANUFACTURER_NAME, BT_GATT_CHRC_READ),
    BT_GATT_DESCRIPTOR(BT_UUID_DIS_MANUFACTURER_NAME, BT_GATT_PERM_READ,
                       read_manuf, NULL, def_manufacturer_name),
#endif /* CONFIG_BLUETOOTH_GATT_DYNAMIC_DB */
    /* IP Support Service Declaration */
    BT_GATT_PRIMARY_SERVICE(BT_UUID_IPSS),
};

static const struct bt_data ad[] = {
    BT_DATA_BYTES(BT_DATA_FLAGS, (BT_LE_AD_GENERAL | BT_LE_AD_NO_BREDR)),
    BT_DATA_BYTES(BT_DATA_UUID16_ALL, 0x20, 0x18),
};

static const struct bt_data sd[] = {
    BT_DATA(BT_DATA_NAME_COMPLETE, def_device_name, 20),
};

static void connected(struct bt_conn *conn, uint8_t err) {
  if (err) {
    printk("Connection failed (err %u)\n", err);
  } else {
    printk("Connected\n");
  }
}

static void disconnected(struct bt_conn *conn, uint8_t reason) {
  printk("Disconnected (reason %u)\n", reason);
}

static struct bt_conn_cb conn_callbacks = {
    .connected = connected, .disconnected = disconnected,
};

void ipss_set_attributes(char *device, char *manufacturer, char *model) {
  if (device) {
    strcpy(def_device_name, device);
  }
  if (manufacturer) {
    strcpy(def_manufacturer_name, manufacturer);
  }
  if (model) {
    strcpy(def_model_number, model);
  }
}
void ipss_init() {
  if (!def_device_name[0]) {
    strcpy(def_device_name, DEFAULT_DEVICE_NAME);
  }
  if (!def_manufacturer_name[0]) {
    strcpy(def_manufacturer_name, DEFAULT_MANUFACTURER);
  }
  if (!def_model_number[0]) {
    strcpy(def_model_number, DEFAULT_MODEL);
  }
  bt_gatt_register(attrs, ARRAY_SIZE(attrs));

  bt_conn_cb_register(&conn_callbacks);
}

int ipss_advertise(void) {
  int err;

  err = bt_le_adv_start(BT_LE_ADV_CONN, ad, ARRAY_SIZE(ad), sd, ARRAY_SIZE(sd));
  if (err) {
    return err;
  }

  return 0;
}
```

## src/ipss.h
```c
/** @file
 *  @brief IPSP Service sample
 */

/*
 * Copyright (c) 2015-2016 Intel Corporation
 *
 * SPDX-License-Identifier: Apache-2.0
 */

#ifdef __cplusplus
extern "C" {
#endif

void ipss_set_attributes(char *device, char *manufacturer, char *model);
void ipss_init();
int ipss_advertise(void);

#ifdef __cplusplus
}
#endif
```

## src/oc_config.h
```c
/****************************************************************************
 *
 * Copyright (c) 2016 Intel Corporation
 *
 * Licensed under the Apache License, Version 2.0 (the "License"),
 * you may not use this file except in compliance with the License.
 * You may obtain a copy of the License at
 *
 *      http://www.apache.org/licenses/LICENSE-2.0
 *
 * Unless required by applicable law or agreed to in writing,
 * software distributed under the License is distributed on an
 * "AS IS" BASIS, WITHOUT WARRANTIES OR CONDITIONS OF ANY KIND,
 * either express or implied. See the License for the specific
 * language governing permissions and limitations under the License.
 *
 ****************************************************************************/

#ifndef OC_CONFIG_H
#define OC_CONFIG_H

/* Time resolution */
#include <stdint.h>
typedef uint64_t oc_clock_time_t;
#include <zephyr.h>
#define OC_CLOCK_CONF_TICKS_PER_SECOND (1000)

#define OC_BYTES_POOL_SIZE (1024)
#define OC_INTS_POOL_SIZE (16)
#define OC_DOUBLES_POOL_SIZE (16)

/* Server-side parameters */
/* Maximum number of server resources */
#define OC_MAX_APP_RESOURCES (1)

/* Common parameters */
// #define OC_BLOCK_WISE_SET_MTU (80)

/* Maximum size of request/response PDUs */
#define OC_MAX_APP_DATA_SIZE (600)

/* Maximum number of concurrent requests */
#define OC_MAX_NUM_CONCURRENT_REQUESTS (2)

/* Maximum number of nodes in a payload tree structure */
#define OC_MAX_NUM_REP_OBJECTS (70)

/* Number of devices on the OCF platform */
#define OC_MAX_NUM_DEVICES (1)

#define OC_MAX_NUM_ENDPOINTS (4)

/* Maximum size of uri for a collection resource */
// #define OC_MAX_COLLECTIONS_INSTANCE_URI_SIZE (64)

/* Security layer */
/* Maximum number of authorized clients */
#define OC_MAX_NUM_SUBJECTS (1)

/* Maximum number of concurrent DTLS sessions */
#define OC_MAX_DTLS_PEERS (1)

/* Maximal number of callbacks invoked before a dynamic resource is deleted */
#define OC_MAX_ON_DELETE_RESOURCE_CBS (2)

/* Max inactivity timeout before tearing down DTLS connection */
#define OC_DTLS_INACTIVITY_TIMEOUT (10)

/* Add request history for deduplicate UDP/DTLS messages */
#define OC_REQUEST_HISTORY

/* Add support observable for oic/res */
// #define OC_DISCOVERY_RESOURCE_OBSERVABLE

/* library features that require persistent storage */
#ifdef OC_SECURITY
#define OC_STORAGE
#endif
#ifdef OC_IDD_API
#define OC_STORAGE
#endif
#ifdef OC_CLOUD
#define OC_STORAGE
#endif
#ifdef OC_SOFTWARE_UPDATE
#define OC_STORAGE
#endif

/* Wipe device name during reset, when oic/con is enabled */
/* Default: Wipe name */
#define OC_WIPE_NAME (1)

#endif /* OC_CONFIG_H */
```

## src/random.c
```c
/****************************************************************************
 *
 * Copyright (c) 2016 Intel Corporation
 *
 * Licensed under the Apache License, Version 2.0 (the "License"),
 * you may not use this file except in compliance with the License.
 * You may obtain a copy of the License at
 *
 *      http://www.apache.org/licenses/LICENSE-2.0
 *
 * Unless required by applicable law or agreed to in writing,
 * software distributed under the License is distributed on an
 * "AS IS" BASIS, WITHOUT WARRANTIES OR CONDITIONS OF ANY KIND,
 * either express or implied. See the License for the specific
 * language governing permissions and limitations under the License.
 *
 ****************************************************************************/

#include "port/oc_random.h"
#include <random/rand32.h>

void
oc_random_init(void)
{
}

// FIXME: Update below to interface with desired PRNG implementation
unsigned int
oc_random_value(void)
{
  return (unsigned int)sys_rand32_get();
}

void
oc_random_destroy(void)
{
}
```

## src/storage.c
```c
/****************************************************************************
 *
 * Copyright (c) 2016 Intel Corporation
 *
 * Licensed under the Apache License, Version 2.0 (the "License"),
 * you may not use this file except in compliance with the License.
 * You may obtain a copy of the License at
 *
 *      http://www.apache.org/licenses/LICENSE-2.0
 *
 * Unless required by applicable law or agreed to in writing,
 * software distributed under the License is distributed on an
 * "AS IS" BASIS, WITHOUT WARRANTIES OR CONDITIONS OF ANY KIND,
 * either express or implied. See the License for the specific
 * language governing permissions and limitations under the License.
 *
 ****************************************************************************/

#include "oc_config.h"

#ifdef OC_STORAGE

#include "port/oc_storage.h"
#include "port/oc_storage_internal.h"

#include <device.h>
#include <flash.h>
#include <zephyr.h>

#include <errno.h>
#include <limits.h>
#include <stdlib.h>
#include <string.h>

#ifndef OC_MEMORY_KEY_NUMBER
#define OC_MEMORY_KEY_NUMBER 4
#endif

#ifndef OC_MEMORY_KEY_SIZE
#define OC_MEMORY_KEY_SIZE 1
#endif

#ifndef OC_MEMORY_KEY_NAME_SIZE
#define OC_MEMORY_KEY_NAME_SIZE 64
#endif

#define OC_MEMMAP_KEY { 0xab, 0xcd, 0xef }

#define OC_MEMMAP_CLOSER_ERASABLE_SECTOR(_pos)                                 \
  (_pos * (_pos / memmap.sector_size))

struct memmap_key
{
  uint8_t key[OC_MEMORY_KEY_SIZE];
  size_t offset;
  size_t size;
};

static struct
{
  struct device *flash;
  size_t sector_size, max_rw_size;
  struct memmap_key keys[OC_MEMORY_KEY_NUMBER];
} memmap;

static unsigned int
align_power2(unsigned int value)
{
  unsigned int left_zeros;

  if (value <= 1)
    return value;

  left_zeros = __builtin_clz(value - 1);
  if (left_zeros <= 1)
    return UINT_MAX;

  return (unsigned int)1 << ((sizeof(value) * 8) - left_zeros);
}

static size_t
find_next_available_sector(void)
{
  size_t times;
  uint8_t key[] = OC_MEMMAP_KEY;

  times = (sizeof(memmap.keys) + sizeof(key)) / memmap.sector_size;
  if ((sizeof(memmap.keys) + sizeof(key)) % memmap.sector_size)
    times++;

  return times * memmap.sector_size;
}

static int
storage_init(size_t initial_offset)
{
  int r;
  uint8_t key[] = OC_MEMMAP_KEY;
  size_t times, extra, off = 0;
  size_t first_available_sector = find_next_available_sector();

  for (r = 0; r < sizeof(memmap.keys) / sizeof(memmap.keys[0]); r++) {
    memmap.keys[r].offset = first_available_sector + (r * memmap.sector_size);
    memmap.keys[r].size = memmap.sector_size * OC_MEMORY_KEY_SIZE;
  }

  r = flash_write_protection_set(memmap.flash, false);
  if (r < 0)
    return r;

  r =
    flash_erase(memmap.flash, OC_MEMMAP_CLOSER_ERASABLE_SECTOR(initial_offset),
                memmap.sector_size);
  if (r < 0)
    return r;

  times = (sizeof(memmap.keys) + sizeof(key)) / memmap.max_rw_size;
  extra = (sizeof(memmap.keys) + sizeof(key)) % memmap.max_rw_size;

  while (times) {
    r = flash_write_protection_set(memmap.flash, false);
    if (r < 0)
      return r;

    if (!off) {
      uint8_t buf[memmap.max_rw_size];

      memcpy(buf, key, sizeof(key));
      memcpy(buf + sizeof(key), memmap.keys, memmap.max_rw_size - sizeof(key));

      r = flash_write(memmap.flash, initial_offset, buf, memmap.max_rw_size);
    } else {
      r = flash_write(memmap.flash, initial_offset + off,
                      (uint8_t *)memmap.keys + off - sizeof(key),
                      memmap.max_rw_size);
    }

    off += memmap.max_rw_size;
    if (r < 0)
      return r;
    times--;
  }

  if (extra) {
    r = flash_write_protection_set(memmap.flash, false);
    if (r < 0)
      return r;
    r = flash_write(memmap.flash, initial_offset + off,
                    (uint8_t *)memmap.keys + off - sizeof(key), extra);
    if (r < 0)
      return r;
  }

  return 0;
}

/*
 * It expects the device name, flash sector size and
 * maximum read/write size separated by comma:
 *
 * device_name,flash_sector_size,max_rw_size
 *
 * For arduino 101 internal flash it will be:
 * W25QXXDV,4096,256
 */
int
oc_storage_config(const char *path)
{
  char *aux, device_name[16];
  unsigned int size;
  size_t initial_offset;
  uint8_t key[] = OC_MEMMAP_KEY;
  int r;

  aux = strstr(path, ",");
  if (!aux)
    return -EINVAL;

  if (aux - path > sizeof(device_name) - 1)
    return -EINVAL;

  memcpy(device_name, path, aux - path);
  device_name[aux - path] = '\0';

  memmap.flash = device_get_binding((char *)device_name);
  if (!memmap.flash)
    return -EINVAL;

#define PARSE_VALUE(_var)                                                      \
  do {                                                                         \
    if (!aux)                                                                  \
      goto err;                                                                \
    errno = 0;                                                                 \
    size = strtoul(aux + 1, NULL, 0);                                          \
    if (errno)                                                                 \
      goto err;                                                                \
    _var = size;                                                               \
    path = aux + 1;                                                            \
    aux = strstr(path, ",");                                                   \
  } while (0)

#define PARSE_VALUE_ALIGNED(_var)                                              \
  do {                                                                         \
    PARSE_VALUE(_var);                                                         \
    _var = align_power2(size / 2 + 1);                                         \
  } while (0)

  PARSE_VALUE_ALIGNED(memmap.sector_size);
  PARSE_VALUE_ALIGNED(memmap.max_rw_size);
  PARSE_VALUE(initial_offset);
#undef PARSE_VALUE
#undef PARSE_VALUE_ALIGNED

  /*
   * Read the initial record to check the position
   * and size of the keys.
   */
  r = flash_read(memmap.flash, initial_offset, &key, sizeof(key));
  if (r < 0)
    goto err;

  if (memcmp(key, (void *)&((uint8_t[])OC_MEMMAP_KEY), sizeof(key))) {
    r = storage_init(initial_offset);
    if (r < 0)
      goto err;
  } else {
    size_t times, extra, off = 0;

    times = sizeof(memmap.keys) / memmap.max_rw_size;
    extra = sizeof(memmap.keys) % memmap.max_rw_size;

    while (times) {
      r = flash_read(memmap.flash, initial_offset + sizeof(key) + off,
                     (uint8_t *)memmap.keys + off, memmap.max_rw_size);
      if (r < 0)
        goto err;
      off += memmap.max_rw_size;
      times--;
    }
    if (extra) {
      r = flash_read(memmap.flash, initial_offset + sizeof(key) + off,
                     (uint8_t *)memmap.keys + off, extra);
      if (r < 0)
        goto err;
    }
  }

  return 0;

err:
  memmap.flash = NULL;
  return -errno;
}

bool
oc_storage_path(char *buffer, size_t buffer_size)
{
  (void)buffer;
  (void)buffer_size;
  return false;
}

int
oc_storage_reset(void)
{
  return -1;
}

static struct memmap_key *
find_key(const char *store)
{
  int i, empty_pos = -1;

  for (i = 0; i < sizeof(memmap.keys) / sizeof(memmap.keys[0]); i++) {
    if (!strcmp(memmap.keys[i].key, store)) {
      return &memmap.keys[i];
    } else if (memmap.keys[i].key[0] == '0') {
      empty_pos = i;
    }
  }

  if (empty_pos != -1) {
    strncpy(memmap.keys[empty_pos].key, store, OC_MEMORY_KEY_SIZE);
    return &memmap.keys[empty_pos];
  }

  return NULL;
}

long
oc_storage_size(const char *store)
{
  return -1;
}

/*
 * store should contains the memory position to read.
 * The value should be multiple of the flash sector size.
 */
long
oc_storage_read(const char *store, uint8_t *buf, size_t size)
{
  int r;
  struct memmap_key *key;
  size_t times = 0, extra = 0;

  times = size / memmap.max_rw_size;
  extra = size % memmap.max_rw_size;

  key = find_key(store);
  if (!key)
    return -ENOENT;

  if (!(times || extra)) {
    r = flash_read(memmap.flash, key->offset, buf, size);
    if (r < 0)
      return r;
  } else {
    size_t off = 0;

    while (times) {
      // TODO: check for overflow of buffer
      r = flash_read(memmap.flash, key->offset + off, buf + off,
                     memmap.max_rw_size);
      if (r < 0)
        return r;
      off += memmap.max_rw_size;
      times--;
    }

    if (extra) {
      r = flash_read(memmap.flash, key->offset + off, buf + off, extra);
      if (r < 0)
        return r;
    }
  }

  return size;
}

/*
 * store should contains the memory position to write.
 * The value should be multiple of the flash sector size.
 */
long
oc_storage_write(const char *store, const uint8_t *buf, size_t size)
{
  int r = 0;
  struct memmap_key *key;
  size_t times = 0, extra = 0, erase_value = memmap.sector_size;

  key = find_key(store);
  if (!key)
    return -ENOENT;

  times = size / memmap.max_rw_size;
  extra = size % memmap.max_rw_size;

  if (times) {
    erase_value *= times;
    if (extra)
      erase_value += memmap.sector_size;
  }

  r = flash_write_protection_set(memmap.flash, false);
  if (r < 0) {
    return r;
  }

  r = flash_erase(memmap.flash, key->offset, erase_value);
  if (r < 0)
    return r;

  if (!(times || extra)) {
    r = flash_write_protection_set(memmap.flash, false);
    if (r < 0)
      return r;

    r = flash_write(memmap.flash, key->offset, buf, size);
    if (r < 0)
      return r;
  } else {
    size_t off = 0;

    while (times) {
      r = flash_write_protection_set(memmap.flash, false);
      if (r < 0)
        return r;

      r = flash_write(memmap.flash, key->offset + off, buf + off,
                      memmap.max_rw_size);
      if (r < 0)
        return r;
      off += memmap.max_rw_size;
      times--;
    }

    if (extra) {
      r = flash_write_protection_set(memmap.flash, false);
      if (r < 0)
        return r;

      r = flash_write(memmap.flash, key->offset + off, buf + off, extra);
      if (r < 0)
        return r;
    }
  }

  return size;
}

#endif /* OC_STORAGE */
```
