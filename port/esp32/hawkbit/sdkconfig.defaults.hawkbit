## port/esp32/hawkbit/sdkconfig.defaults.hawkbit
```kconfig
#
# IoTivity Example Configuration
#
CONFIG_PLGD_DEV_HAWKBIT=y
CONFIG_APP_DEBUG=y
# end of IoTivity Example Configuration
```

## port/esp32/main/Kconfig.projbuild
```kconfig
menu "IoTivity Example Configuration"

config WIFI_SSID
    string "WiFi SSID"
	default "myssid"
	help
		SSID (network name) for the ESP32 to connect to.

config WIFI_PASSWORD
    string "WiFi Password"
	default "myssid"
	help
		WiFi password (WPA or WPA2) for the ESP32 to match.
		can be blank if the network has no security set.

config SNTP_TIME_SERVER
    string "SNTP server name"
    default "pool.ntp.org"
    help
        Hostname of the main SNTP server.

config OC_DEBUG
    bool "OC_DEBUG"
    help
        enable or disable IoTivity-constrained debug

config APP_DEBUG
    bool "APP_DEBUG"
    help
        enable or disable application debug

config DYNAMIC
    bool "DYNAMIC"
    default "y"
    help
        enable or disable DYNAMIC

config SECURE
    bool "SECURE"
    default "y"
    help
        enable or disable SECURE

config IPV4
    bool "IPV4"
    default "y"
    help
        enable or disable IPV4

config TCP
    bool "TCP"
    default "y"
    help
        enable or disable TCP

config CLOUD
    bool "CLOUD"
    default "y"
    help
        enable or disable CLOUD

config PLGD_DEV_TIME
    bool "PLGD_DEV_TIME"
    default "y"
    help
        enable or disable PLGD_DEV_TIME

config PLGD_DEV_HAWKBIT
    bool "PLGD_DEV_HAWKBIT"
    help
        enable or disable Software Update implementation using Hawkbit

config BLINK_GPIO
    int "Blink GPIO number"
    range 0 34
    default 13
    help
        GPIO number (IOxx) to blink on and off.

        Some GPIOs are used for other purposes (flash connections, etc.) and cannot be used to blink.

        GPIOs 35-39 are input-only so cannot be used as outputs.

endmenu
```

## port/esp32/sdkconfig.defaults
```kconfig
# Default sdkconfig parameters to use the IoTivity

# CONFIG_OC_DEBUG=y
CONFIG_IPV4=y
CONFIG_TCP=y
CONFIG_CLOUD=y
CONFIG_DYNAMIC=y
CONFIG_SECURE=y
CONFIG_BLINK_GPIO=13

CONFIG_LWIP_MAX_SOCKETS=16
CONFIG_LWIP_NETBUF_RECVINFO=y
CONFIG_LWIP_SO_RCVBUF=y

CONFIG_MBEDTLS_DEBUG=y

CONFIG_MBEDTLS_ECDSA_DETERMINISTIC=y
CONFIG_MBEDTLS_SHA512_C=y

CONFIG_MBEDTLS_PSK_MODES=y
CONFIG_MBEDTLS_KEY_EXCHANGE_PSK=y
CONFIG_MBEDTLS_PSK_MODES=y
CONFIG_MBEDTLS_KEY_EXCHANGE_PSK=y
CONFIG_MBEDTLS_KEY_EXCHANGE_ECDHE_PSK=y
CONFIG_MBEDTLS_KEY_EXCHANGE_ELLIPTIC_CURVE=y
CONFIG_MBEDTLS_KEY_EXCHANGE_ECDHE_ECDSA=y
CONFIG_MBEDTLS_KEY_EXCHANGE_ECDH_ECDSA=y
CONFIG_MBEDTLS_SSL_PROTO_TLS1_2=y
CONFIG_MBEDTLS_SSL_PROTO_DTLS=y
CONFIG_MBEDTLS_SSL_ALPN=y
CONFIG_MBEDTLS_CLIENT_SSL_SESSION_TICKETS=y
CONFIG_MBEDTLS_SERVER_SSL_SESSION_TICKETS=y

CONFIG_MBEDTLS_AES_C=y
CONFIG_MBEDTLS_RC4_DISABLED=y
CONFIG_MBEDTLS_CCM_C=y
CONFIG_MBEDTLS_GCM_C=y

CONFIG_MBEDTLS_PEM_PARSE_C=y
CONFIG_MBEDTLS_PEM_WRITE_C=y
CONFIG_MBEDTLS_X509_CRL_PARSE_C=y
CONFIG_MBEDTLS_X509_CSR_PARSE_C=y

CONFIG_MBEDTLS_ECP_C=y
CONFIG_MBEDTLS_ECDH_C=y
CONFIG_MBEDTLS_ECDSA_C=y

CONFIG_VFS_SUPPORT_SELECT=y

#
# Partition Table
#
# CONFIG_PARTITION_TABLE_SINGLE_APP is not set
# CONFIG_PARTITION_TABLE_TWO_OTA is not set
CONFIG_PARTITION_TABLE_CUSTOM=y
CONFIG_PARTITION_TABLE_CUSTOM_FILENAME="partitions.csv"
CONFIG_PARTITION_TABLE_FILENAME="partitions.csv"
CONFIG_PARTITION_TABLE_OFFSET=0x8000
CONFIG_PARTITION_TABLE_MD5=y
# end of Partition Table

#
# Compiler options
#
# CONFIG_COMPILER_OPTIMIZATION_DEFAULT is not set
# CONFIG_COMPILER_OPTIMIZATION_SIZE is not set
CONFIG_COMPILER_OPTIMIZATION_PERF=y
# CONFIG_COMPILER_OPTIMIZATION_NONE is not set
CONFIG_COMPILER_OPTIMIZATION_ASSERTIONS_ENABLE=y
# CONFIG_COMPILER_OPTIMIZATION_ASSERTIONS_SILENT is not set
# CONFIG_COMPILER_OPTIMIZATION_ASSERTIONS_DISABLE is not set
# CONFIG_COMPILER_CXX_EXCEPTIONS is not set
# CONFIG_COMPILER_CXX_RTTI is not set
CONFIG_COMPILER_STACK_CHECK_MODE_NONE=y
# CONFIG_COMPILER_STACK_CHECK_MODE_NORM is not set
# CONFIG_COMPILER_STACK_CHECK_MODE_STRONG is not set
# CONFIG_COMPILER_STACK_CHECK_MODE_ALL is not set
# CONFIG_COMPILER_WARN_WRITE_STRINGS is not set
# CONFIG_COMPILER_DISABLE_GCC8_WARNINGS is not set
# CONFIG_COMPILER_DUMP_RTL_FILES is not set
# end of Compiler options
```

## port/tizenrt/iotlite_apps/iotlite/Kconfig
```kconfig
#
# For a description of the syntax of this configuration file,
# see kconfig-language at https://www.kernel.org/doc/Documentation/kbuild/kconfig-language.txt
#

config EXAMPLES_IOTLITE
	bool "Enable IoTivity-Lite Demo Example"
	default n
	depends on ENABLE_IOTIVITY_CONSTRAINED
	---help---
		Enable IoTivity-lite demo example
```

## tests/port/tizenrt/examples/iotivity_constrained_example/Kconfig
```kconfig
#
# For a description of the syntax of this configuration file,
# see kconfig-language at https://www.kernel.org/doc/Documentation/kbuild/kconfig-language.txt
#

config EXAMPLES_IOTIVITY_CONSTRAINED
	bool "iotivity_constrained_example"
	select ENABLE_IOTIVITY_CONSTRAINED
	default n
	---help---
		Enable the iotivity_constrainted_example

if EXAMPLES_IOTIVITY_CONSTRAINED

config EXAMPLES_IOTIVITY_CONSTRAINED_PROGNAME
	string "Program name"
	default "iotivity_constrained_example"
	depends on BUILD_KERNEL
	---help---
		This is the name of the program that will be use when the TASH ELF
		program is installed.

endif

config USER_ENTRYPOINT
	string
	default "iotivity_constrained_example_main" if ENTRY_IOTIVITY_CONSTRAINED_EXAMPLE
```
